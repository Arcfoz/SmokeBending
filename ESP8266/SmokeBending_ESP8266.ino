#include <WiFiManager.h>
#include <FirebaseESP8266.h>
#include <ESP8266WiFi.h>
#include <Wire.h>
#include <Adafruit_GFX.h>
#include <Adafruit_SSD1306.h>
#include <Adafruit_Sensor.h>

#define RELAY1 14
#define RELAY2 12
#define RESET 02

#define SCREEN_WIDTH 128 // OLED display width, in pixels
#define SCREEN_HEIGHT 64 // OLED display height, in pixels

Adafruit_SSD1306 display(SCREEN_WIDTH, SCREEN_HEIGHT, &Wire, -1);

String fanstatus = "OFF";
String speedstatus = "SLOW";
int online = 0;

const unsigned char smokebendingLogo [] PROGMEM = {
  0x00, 0x00, 0x00, 0x00, 0x00, 0x00, 0x00, 0x00, 0x00, 0x00, 0x00, 0x00, 0x00, 0x00, 0x00, 0x00, 
  0x00, 0x00, 0x00, 0x00, 0x00, 0x00, 0x00, 0x00, 0x00, 0x00, 0x00, 0x00, 0x00, 0x00, 0x00, 0x00, 
  0x00, 0x00, 0x00, 0x00, 0x00, 0x00, 0x00, 0x00, 0x00, 0x00, 0x00, 0x00, 0x00, 0x00, 0x00, 0x00, 
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  0x00, 0x00, 0x00, 0x00, 0x00, 0x00, 0x00, 0x00, 0x00, 0x00, 0x00, 0x00, 0x00, 0x00, 0x00, 0x00
};


#define FIREBASE_HOST "smokebending-86277-default-rtdb.asia-southeast1.firebasedatabase.app/" //Without http:// or https:// schemes //sesuaikan dengan FIREBASE_HOST masing-masing
#define FIREBASE_AUTH "RWi*****cWg" //sesuaikan dengan FIREBASE_HOST masing-masing
#define WIFI_SSID "SmokeBending" //sesuaikan dengan hotspot yang digunakan
#define WIFI_PASSWORD "1234567890"

//Define FirebaseESP8266 data object
FirebaseData MQ7;
FirebaseData FAN;
FirebaseData SPEED;


void setup()
{

  Serial.begin(9600);

  pinMode(LED_BUILTIN, OUTPUT);
  pinMode(RELAY1, OUTPUT);
  pinMode(RELAY2, OUTPUT);
  pinMode(RESET, INPUT);
  
  display.begin(SSD1306_SWITCHCAPVCC, 0x3C);
  display.clearDisplay();
  display.drawBitmap(0, 0, smokebendingLogo, 128, 64, 1);
  display.display();
  delay(3000);

  display.clearDisplay();
  display.setTextColor(WHITE);
  display.setCursor(0,0);
  display.println("Wifi connecting to ");
  display.println(WIFI_SSID);
  display.println("\nConnecting");
  display.display();
  
  WiFi.begin(WIFI_SSID, WIFI_PASSWORD);
  Serial.print("Connecting to Wi-Fi");
  while (WiFi.status() != WL_CONNECTED)
  {
    WiFiManager wm;
    wm.autoConnect("Smoke-Bending");
  }
  Serial.println();
  Serial.print("Connected with IP: ");
  Serial.println(WiFi.localIP());
  Serial.println();

  display.clearDisplay();
  display.setCursor(0, 24);
  display.setTextWrap(0);
  display.setCursor(19, 24);
  display.println("Wifi connected!");
  display.setCursor(0, 38);
  display.drawRoundRect(13, 22, 100, 12, 3, 1);
  display.setCursor(13, 38);
  display.println(WiFi.localIP());

  display.display();
  delay(2000);

  Firebase.begin(FIREBASE_HOST, FIREBASE_AUTH);
  Firebase.reconnectWiFi(true);

}

void loop() {
  int val;
  int statusfan = 0;
  float sensorValue;
  float sensorVoltage;
  
  sensorValue = analogRead(A0);
  sensorVoltage = sensorValue/1024*5.0;

  val = digitalRead(RESET); // check the state of the button
  if(val==LOW) // if button is pressed, turn LED on
  {
    Serial.println("RESTART");
    ESP.restart();
  }
  
  if (Firebase.setFloat(MQ7, "/smokebending/sensor1/mq7", sensorVoltage))
  {
    Serial.println("PASSED");
  }  else
  {
    displayolederror();
    Serial.println("REASON: " + MQ7.errorReason());
    return;
  }

  int kondisi = 1;

  if(sensorVoltage > 1 && sensorVoltage < 3 && online==0){
    digitalWrite(RELAY1, HIGH);
    digitalWrite(RELAY2, LOW);
    fanstatus = "ON";
    tone(13, 450);
    speedstatus = "SLOW";
    }
  else if (sensorVoltage >= 3 && online==0){
    digitalWrite(RELAY1, HIGH);
    digitalWrite(RELAY2, HIGH);
    tone(13, 900);
    fanstatus = "ON";
    speedstatus = "FAST";
    }
  else if (online==0) {
    digitalWrite(RELAY1, LOW);
    digitalWrite(RELAY2, LOW);
    noTone(13);
    fanstatus = "OFF";
    speedstatus = "OFF";
    }
   
  if (Firebase.getInt(FAN, "/smokebending/sensor2/fan")){
    if (FAN.stringData() == "1") {
      online = 1;
      digitalWrite(RELAY1, HIGH);
      fanstatus = "ON";
      statusfan = 1;
    }
  else if (FAN.stringData() == "0" && online == 1){
    online = 0;
    digitalWrite(RELAY1, LOW);
    fanstatus = "OFF";
    statusfan = 0;
    speedstatus = "OFF";
    }
  }

  if (Firebase.getInt(SPEED, "/smokebending/sensor3/fanspeed") && statusfan == 1 && online == 1){
    if (SPEED.stringData() == "1") {
    digitalWrite(RELAY2, HIGH);
    speedstatus = "FAST";
    }
  else if (SPEED.stringData() == "0"){
    digitalWrite(RELAY2, LOW);
    speedstatus = "SLOW";
    }
  }

  displayoled(sensorVoltage, fanstatus);
  delay(1000);
}

void displayoled(float mq7value, String fanstatus){
  display.clearDisplay();
  display.setTextSize(1);
  display.setCursor(0, 0);
  display.print("MQ-7: ");
  display.setTextSize(2);
  display.setCursor(0, 10);
  display.print(mq7value);
  display.print(" %");
  display.setCursor(0, 30);
  display.setTextSize(1);
  display.println("Fan:");
  display.setCursor(0, 40);
  display.setTextSize(2);
  display.println(fanstatus+" ("+speedstatus+")");
  display.display(); 
  }
void displayolederror() {
  digitalWrite(RELAY1, LOW);
  digitalWrite(RELAY2, LOW);
  display.clearDisplay();
  display.setTextSize(1);
  display.setCursor(0, 10);
  display.setTextWrap(0);
  display.setCursor(13, 10);
  display.println("Terjadi Kesalahan");
  display.setTextWrap(0);
  display.setCursor(19, 18);
  display.println("dalam melakukan");
  display.setTextWrap(0);
  display.setCursor(40, 26);
  display.println("koneksi!");
  display.setTextWrap(0);
  display.setCursor(28, 34);
  display.println("(Cek kembali");
  display.setTextWrap(0);
  display.setCursor(13, 42);
  display.println("koneksi internet)");
  display.display();
}
